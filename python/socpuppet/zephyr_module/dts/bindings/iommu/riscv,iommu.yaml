## python/socpuppet/zephyr_module/dts/bindings/iommu/riscv,iommu.yaml
```yaml
description: |
  A RISC-V IOMMU, as the RISC-V IOMMU specification describes one: what
  stands between devices and memory. A device is named to it by one cell,
  the device ID it knows the device by, which for a PCIe device is its
  requester ID. socpuppet's has wired interrupts alone.

compatible: "riscv,iommu"

include: base.yaml

properties:
  reg:
    required: true

  interrupts:
    required: true

  "#iommu-cells":
    type: int
    required: true
    const: 1

iommu-cells:
  - id
```

## python/socpuppet/zephyr_module/dts/bindings/pcie/socpuppet,pcie.yaml
```yaml
description: |
  The PCIe root complex of a socpuppet platform. It has a configuration
  window (ECAM) and one memory window, in which an address on the PCIe bus
  is the CPU's address.

compatible: "socpuppet,pcie"

include: pcie-controller.yaml

properties:
  reg:
    required: true
    description: The configuration window. Each bus has 1 MiB of it.

  ranges:
    type: array
    required: true
    description: |
      The memory window, as one range of 32-bit memory space that is not
      prefetchable.

  bus-range:
    type: array
    description: The first and the last bus the configuration window holds.

  msi-parent:
    type: phandle
    required: true
    description: |
      Where a device on the link sends its interrupt messages: the
      platform's MSI-to-PLIC bridge (socpuppet,msi-plic-bridge).
```

## python/socpuppet/zephyr_module/dts/bindings/rtc/google,goldfish-rtc.yaml
```yaml
description: |
  The Goldfish real-time clock: the clock of Android's emulator, which
  QEMU's `virt` machine has too, and which Linux's `rtc-goldfish` drives.
  It counts nanoseconds since 1970. socpuppet's module has the driver.

  Its interrupt is its alarm's, which the driver does not offer.

compatible: "google,goldfish-rtc"

include: [rtc-device.yaml]

properties:
  reg:
    required: true
```

## python/socpuppet/zephyr_module/dts/bindings/ssd/socpuppet,dma-engine.yaml
```yaml
description: |
  The DMA engine of a socpuppet SSD: what copies between the host's memory
  and the SSD's own. The firmware says where in each and how many bytes.

  `interrupts-extended` names the PLIC source of its line, which is high
  while a copy is done, or has failed, and the CPU asked to be told. A driver that
  asks the status register instead has no use for it.

compatible: "socpuppet,dma-engine"

include: base.yaml

properties:
  reg:
    required: true
```

## python/socpuppet/zephyr_module/dts/bindings/ssd/socpuppet,flash-controller.yaml
```yaml
description: |
  The flash controller of a socpuppet SSD: what moves a page between the
  NAND flash chip and the SSD's own memory, and erases a block. The
  firmware says which page and where it is in memory.

  `interrupts-extended` names the PLIC source of its line, which is high
  while a command is done, or has failed, and the CPU asked to be told. A driver that
  asks the status register instead has no use for it.

compatible: "socpuppet,flash-controller"

include: base.yaml

properties:
  reg:
    required: true
```

## python/socpuppet/zephyr_module/dts/bindings/ssd/socpuppet,nvme-frontend.yaml
```yaml
description: |
  The NVMe frontend of a socpuppet SSD, as the SSD's own CPU sees it: the
  hardware that keeps the host's queues. It holds each command it has
  fetched for the firmware to read, and posts the completion the firmware
  gives it.

  `interrupts-extended` names the PLIC source of its line, which is high
  while it has something to tell the CPU that the CPU asked to be told:
  the host has enabled or reset the controller, or a command is waiting.

compatible: "socpuppet,nvme-frontend"

include: base.yaml

properties:
  reg:
    required: true

  interrupts-extended:
    required: true
```

## python/socpuppet/zephyr_module/dts/bindings/syscon/socpuppet,system-controller.yaml
```yaml
description: |
  The system controller of a socpuppet CPU: which die the CPU is on, where
  its boot ROM finds the image to start, why it was last reset, and a
  register that asks for a reset.

  It is a `syscon` as well, which is Zephyr's name for a block of registers
  that other code reaches into, and what Zephyr's syscon driver is for:
  `syscon_read_reg()` with an offset from socpuppet/regs/system_controller.h.

compatible: "socpuppet,system-controller"

include: syscon.yaml
```

## python/socpuppet/zephyr_module/soc/socpuppet/Kconfig.soc
```kconfig
config SOC_FAMILY_SOCPUPPET
	bool

config SOC_FAMILY
	default "socpuppet" if SOC_FAMILY_SOCPUPPET

rsource "*/Kconfig.soc"
```

## python/socpuppet/zephyr_module/soc/socpuppet/socpuppet_rv32/Kconfig.soc
```kconfig
config SOC_SOCPUPPET_RV32
	bool
	select SOC_FAMILY_SOCPUPPET

config SOC
	default "socpuppet_rv32" if SOC_SOCPUPPET_RV32
```

## python/socpuppet/zephyr_module/soc/socpuppet/socpuppet_rv64/Kconfig.soc
```kconfig
config SOC_SOCPUPPET_RV64
	bool
	select SOC_FAMILY_SOCPUPPET

config SOC
	default "socpuppet_rv64" if SOC_SOCPUPPET_RV64
```

## spikes/aia/module/dts/bindings/pcie/socpuppet,pcie.yaml
```yaml
description: |
  The PCIe root complex of a socpuppet platform. It has a configuration
  window (ECAM) and one memory window, in which an address on the PCIe bus
  is the CPU's address.

compatible: "socpuppet,pcie"

include: pcie-controller.yaml

properties:
  reg:
    required: true
    description: The configuration window. Each bus has 1 MiB of it.

  ranges:
    type: array
    required: true
    description: |
      The memory window, as one range of 32-bit memory space that is not
      prefetchable.

  bus-range:
    type: array
    description: The first and the last bus the configuration window holds.

  msi-parent:
    type: phandle
    required: true
    description: |
      Where a device on the link sends its interrupt messages: the hart's
      IMSIC (riscv,imsic).

  socpuppet,msi-identities:
    type: array
    required: true
    description: |
      The identity each of the device's vectors interrupts with, in the
      order of the vectors.
```

## spikes/boot/zephyr/overlay/dts/bindings/interrupt-controller/socpuppet,aplic.yaml
```yaml
description: |
  An APLIC of a socpuppet platform. It is Zephyr's riscv,aplic, and says
  one thing more: which of its sources have a device's line on them. A
  board can have more than one APLIC, and an interrupt's number does not
  say whose source it is.

compatible: "socpuppet,aplic"

include: riscv,aplic.yaml

properties:
  socpuppet,sources:
    type: array
    description: The sources that have a device's interrupt line on them.
```

## spikes/boot/zephyr/overlay/dts/bindings/syscon/socpuppet,system-controller.yaml
```yaml
description: |
  The system controller of a socpuppet CPU: which die it is on, where to
  boot from, why it was last reset, and a register that asks for a reset.

compatible: "socpuppet,system-controller"

include: syscon.yaml
```
