## CMakeLists.txt
```
# Zephyr's own test of a flash driver, built for the board socpuppet_ssd,
# where the flash is the SSD's NAND behind its flash controller. See
# README.md beside this file.
cmake_minimum_required(VERSION 3.20.0)

find_package(Zephyr REQUIRED HINTS $ENV{ZEPHYR_BASE})
project(socpuppet_flash_test)

# The test itself is Zephyr's, as it is. With it goes what a NAND adds.
target_sources(app PRIVATE
  $ENV{ZEPHYR_BASE}/tests/drivers/flash/common/src/main.c
  src/nand.c)
```

## Kconfig
```
# The test's own options are Zephyr's, with the test.
source "$(ZEPHYR_BASE)/tests/drivers/flash/common/Kconfig"
```

## prj.conf
```kconfig
# What Zephyr's test asks for (its own prj.conf).
CONFIG_TEST=y
CONFIG_ZTEST=y
CONFIG_FLASH=y
CONFIG_FLASH_PAGE_LAYOUT=y
CONFIG_MAIN_STACK_SIZE=2048

# What a NAND needs of it. A NAND is written a whole page at a time, and
# the test writes in pieces of this size, from buffers on its stack.
CONFIG_FLASH_FILL_BUFFER_SIZE=4096
CONFIG_ZTEST_STACK_SIZE=32768

# The size the test expects the driver to report: the NAND of the SSD that
# socpuppet.boards.ssd describes when it is not told a size, a drive of
# 2 MiB and a block of 256 KiB for the FTL's reserve.
CONFIG_TEST_DRIVER_FLASH_SIZE=2359296
```

## boards/socpuppet_ssd.overlay
```dts
/*
 * Where Zephyr's flash test may write: it looks for a partition called
 * storage_partition. The first 1 MiB of the NAND is four blocks, and the
 * test uses two.
 */
&ssd_flash {
	partitions {
		compatible = "fixed-partitions";
		#address-cells = <1>;
		#size-cells = <1>;

		storage_partition: partition@0 {
			label = "storage";
			reg = <0x0 0x100000>;
		};
	};
};
```

## src/nand.c
```c
/*
 * What a NAND adds to Zephyr's flash test, for the driver of the SSD's
 * flash controller: a write of more than one page, and what the driver
 * refuses because a NAND cannot do it.
 *
 * Zephyr's test (tests/drivers/flash/common in Zephyr) writes a page at a
 * time, and only what a flash can take.
 */

#include <errno.h>
#include <stdint.h>

#include <zephyr/device.h>
#include <zephyr/drivers/flash.h>
#include <zephyr/storage/flash_map.h>
#include <zephyr/ztest.h>

/* The partition Zephyr's test uses, from the board's overlay. */
#define AREA storage_partition

/* Room for two NAND pages, of the biggest size the driver was built for. */
#define TWO_PAGES (2 * CONFIG_SOCPUPPET_FLASH_CONTROLLER_LARGEST_PAGE)

static const struct device *const nand = PARTITION_DEVICE(AREA);
/*
 * The NAND block these tests write in: the partition's third. Zephyr's
 * test has the first two.
 */
static struct flash_pages_info block;
static size_t page_size;
static uint8_t written[TWO_PAGES];
static uint8_t read_back[TWO_PAGES];

static void *nand_setup(void)
{
	struct flash_pages_info first;

	zassert_true(device_is_ready(nand));
	page_size = flash_get_write_block_size(nand);
	zassert_true(2 * page_size <= TWO_PAGES);
	zassert_ok(flash_get_page_info_by_offs(nand, PARTITION_OFFSET(AREA), &first));
	zassert_ok(flash_get_page_info_by_idx(nand, first.index + 2, &block));
	/* No two neighbours the same, and the two pages not alike. */
	for (size_t at = 0; at < TWO_PAGES; ++at) {
		written[at] = (uint8_t)(at * 7 + at / page_size);
	}

	return NULL;
}

static void nand_before(void *fixture)
{
	ARG_UNUSED(fixture);

	zassert_ok(flash_erase(nand, block.start_offset, block.size));
}

ZTEST(nand, test_a_write_of_two_pages_reads_back_in_one_read)
{
	/* Not at the start of the block, so that a page number matters. */
	off_t at = block.start_offset + page_size;

	zassert_ok(flash_write(nand, at, written, 2 * page_size));

	zassert_ok(flash_read(nand, at, read_back, 2 * page_size));
	zassert_mem_equal(read_back, written, 2 * page_size);
}

ZTEST(nand, test_a_write_that_is_not_of_whole_pages_is_refused_and_writes_nothing)
{
	zassert_equal(flash_write(nand, block.start_offset, written, page_size / 2), -EINVAL);
	zassert_equal(flash_write(nand, block.start_offset + 1, written, page_size), -EINVAL);

	/* An erased NAND reads as all ones. */
	zassert_ok(flash_read(nand, block.start_offset, read_back, 2 * page_size));
	for (size_t at = 0; at < 2 * page_size; ++at) {
		zassert_equal(read_back[at], 0xFF, "byte %zu was written", at);
	}
}

ZTEST(nand, test_an_erase_that_is_not_of_whole_blocks_is_refused_and_erases_nothing)
{
	zassert_ok(flash_write(nand, block.start_offset, written, page_size));

	zassert_equal(flash_erase(nand, block.start_offset, block.size / 2), -EINVAL);
	zassert_equal(flash_erase(nand, block.start_offset + page_size, block.size), -EINVAL);

	zassert_ok(flash_read(nand, block.start_offset, read_back, page_size));
	zassert_mem_equal(read_back, written, page_size);
}

ZTEST(nand, test_a_read_that_runs_past_the_end_of_the_nand_is_refused)
{
	uint64_t size;

	zassert_ok(flash_get_size(nand, &size));

	zassert_equal(flash_read(nand, (off_t)size - 1, read_back, 2), -EINVAL);
}

ZTEST(nand, test_a_write_that_runs_past_the_end_of_the_nand_is_refused)
{
	uint64_t size;

	zassert_ok(flash_get_size(nand, &size));

	/* Whole pages, the first of them the NAND's last. */
	zassert_equal(flash_write(nand, (off_t)(size - page_size), written, 2 * page_size),
		      -EINVAL);
}

ZTEST(nand, test_an_erase_that_runs_past_the_end_of_the_nand_is_refused)
{
	uint64_t size;

	zassert_ok(flash_get_size(nand, &size));

	/* Whole blocks, the first of them the NAND's last. */
	zassert_equal(flash_erase(nand, (off_t)(size - block.size), 2 * block.size), -EINVAL);
}

ZTEST_SUITE(nand, NULL, nand_setup, nand_before, NULL, NULL);
```
