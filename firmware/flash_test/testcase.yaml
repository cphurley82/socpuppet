## python/socpuppet/zephyr_module/boards/shields/socpuppet_host_drive/Kconfig.shield
```kconfig
config SHIELD_SOCPUPPET_HOST_DRIVE
	def_bool $(shields_list_contains,socpuppet_host_drive)
```

## python/socpuppet/zephyr_module/boards/shields/socpuppet_host_gpio_loopback/Kconfig.shield
```kconfig
config SHIELD_SOCPUPPET_HOST_GPIO_LOOPBACK
	def_bool $(shields_list_contains,socpuppet_host_gpio_loopback)
```

## python/socpuppet/zephyr_module/boards/shields/socpuppet_host_i2c_ram/Kconfig.shield
```kconfig
config SHIELD_SOCPUPPET_HOST_I2C_RAM
	def_bool $(shields_list_contains,socpuppet_host_i2c_ram)
```

## python/socpuppet/zephyr_module/boards/shields/socpuppet_host_iommu/Kconfig.shield
```kconfig
config SHIELD_SOCPUPPET_HOST_IOMMU
	def_bool $(shields_list_contains,socpuppet_host_iommu)
```

## python/socpuppet/zephyr_module/boards/shields/socpuppet_host_spi_loopback/Kconfig.shield
```kconfig
config SHIELD_SOCPUPPET_HOST_SPI_LOOPBACK
	def_bool $(shields_list_contains,socpuppet_host_spi_loopback)
```

## python/socpuppet/zephyr_module/boards/shields/socpuppet_host_virtio/Kconfig.shield
```kconfig
config SHIELD_SOCPUPPET_HOST_VIRTIO
	def_bool $(shields_list_contains,socpuppet_host_virtio)
```

## python/socpuppet/zephyr_module/boards/shields/socpuppet_host_virtio_console/Kconfig.shield
```kconfig
config SHIELD_SOCPUPPET_HOST_VIRTIO_CONSOLE
	def_bool $(shields_list_contains,socpuppet_host_virtio_console)
```

## python/socpuppet/zephyr_module/boards/shields/socpuppet_ssd_host/Kconfig.shield
```kconfig
config SHIELD_SOCPUPPET_SSD_HOST
	def_bool $(shields_list_contains,socpuppet_ssd_host)
```

## python/socpuppet/zephyr_module/boards/socpuppet/socpuppet_host/board.yml
```yaml
board:
  name: socpuppet_host
  full_name: socpuppet host
  socs:
    - name: socpuppet_rv64
```

## python/socpuppet/zephyr_module/boards/socpuppet/socpuppet_iomgr/board.yml
```yaml
board:
  name: socpuppet_iomgr
  full_name: socpuppet IO-die manager
  socs:
    - name: socpuppet_rv32
```

## python/socpuppet/zephyr_module/boards/socpuppet/socpuppet_ssd/board.yml
```yaml
board:
  name: socpuppet_ssd
  full_name: socpuppet SSD
  socs:
    - name: socpuppet_rv32
```

## python/socpuppet/zephyr_module/dts/bindings/d2d/socpuppet,ucie-link.yaml
```yaml
description: |
  One end of a socpuppet die-to-die link, in the style of UCIe, as the
  firmware on its own die sees it: the registers that train the link, say
  what it is doing, and reach the registers at the other end of it over
  the link's sideband.

  The firmware on one die trains the link and then lets the other die out
  of reset, which is a register at the far end. That makes this a reset
  controller with one line, number 0, which is the other die.

  `interrupts-extended` names the PLIC source of its line, which is high
  while the link has something to tell the firmware that the firmware
  asked to be told: that its status has changed.

compatible: "socpuppet,ucie-link"

include: [base.yaml, reset-controller.yaml]

properties:
  reg:
    required: true

  interrupts-extended:
    required: true

  "#reset-cells":
    const: 1

reset-cells:
  - id
```

## python/socpuppet/zephyr_module/dts/bindings/interrupt-controller/socpuppet,msi-plic-bridge.yaml
```yaml
description: |
  What turns message-signalled interrupts (MSI) into interrupts of a PLIC,
  which only has lines. It is one 32-bit register. A device interrupts by
  writing the number of a vector to it, and the bridge pulses that
  vector's line.

  `interrupts-extended` names the PLIC source of each vector's line, in
  the order of the vectors.

compatible: "socpuppet,msi-plic-bridge"

include: base.yaml

properties:
  reg:
    required: true

  msi-controller:
    type: boolean
    description: Marks what takes interrupt messages, as devicetrees do.
```
