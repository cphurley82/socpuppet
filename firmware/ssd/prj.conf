## CMakeLists.txt
```
# The firmware of socpuppet's SSD: a Zephyr application for the board
# socpuppet_ssd. See README.md beside this file.
cmake_minimum_required(VERSION 3.20.0)

find_package(Zephyr REQUIRED HINTS $ENV{ZEPHYR_BASE})
project(socpuppet_ssd_firmware)

target_sources(app PRIVATE
  src/admin.c
  src/buffer.c
  src/data.c
  src/ftl.c
  src/io.c
  src/main.c)
```

## prj.conf
```kconfig
# The NAND is reached through Zephyr's flash API, by the driver for the
# SSD's flash controller in socpuppet's Zephyr module. The drivers for the
# NVMe frontend and the DMA engine need nothing asked of them: they are
# built because the board has the devices.
CONFIG_FLASH=y

# A driver that cannot start says why in Zephyr's log, and the firmware
# has no drive without its drivers. The minimal log is a line on the
# console as it happens, marked "E:" for an error.
CONFIG_LOG=y
CONFIG_LOG_MODE_MINIMAL=y
```

## src/main.c
```c
/*
 * The firmware of socpuppet's SSD.
 *
 * The SSD's hardware keeps the host's queues and moves the data, and the
 * firmware makes the decisions. What it does, for ever:
 *
 *   1. Wait for the NVMe frontend to say something has happened.
 *   2. If the host has reset or enabled the controller, see to that.
 *   3. If a command is waiting, read it, do what it says, and have the
 *      frontend post how it went.
 *   4. If the host is shutting the drive down, keep the FTL's table on the
 *      NAND, and say the shutdown is complete.
 *
 * python/socpuppet/ssd_firmware.py in socpuppet is the same firmware as a
 * Python script, which stands in for this one where there is no CPU.
 */

#include <zephyr/device.h>
#include <zephyr/devicetree.h>
#include <zephyr/kernel.h>
#include <zephyr/sys/printk.h>

#include <socpuppet/drivers/nvme_frontend.h>

#include "ftl.h"
#include "ssd.h"

const struct device *const ssd_frontend = DEVICE_DT_GET_ONE(socpuppet_nvme_frontend);
const struct device *const ssd_dma = DEVICE_DT_GET_ONE(socpuppet_dma_engine);
const struct device *const ssd_nand = DEVICE_DT_GET_ONE(socpuppet_flash_controller);

BUILD_ASSERT(sizeof(struct nvme_command) == NVME_FRONTEND_COMMAND_SIZE,
	     "What the frontend hands over is one whole NVMe command.");

static void deal_with_the_command(void)
{
	struct nvme_command command;
	uint16_t from_queue = nvme_frontend_read_command(ssd_frontend, command.bytes);
	/*
	 * Queue 0 is the admin queue. The same opcode means one thing there
	 * and another on an I/O queue.
	 */
	struct nvme_outcome outcome =
		from_queue == 0 ? admin_command(&command) : io_command(&command);

	nvme_frontend_post(ssd_frontend, outcome.status, outcome.result);
}

int main(void)
{
	/* With no NAND there is no drive. The FTL has said what is wrong. */
	if (ftl_start() != 0) {
		printk("The SSD's firmware stops.\n");
		return 0;
	}
	admin_start();
	printk("socpuppet SSD firmware: a drive of %u pages of %u bytes\n", ftl_pages(),
	       ftl_page_size());

	for (;;) {
		uint32_t happened = nvme_frontend_wait(ssd_frontend);

		/*
		 * The reset first: what the host enabled is the controller as
		 * it is after it. The queues are gone, and what is on the
		 * drive stays. The acknowledgement comes last, because it
		 * says the firmware has let go of everything from before.
		 */
		if ((happened & NVME_FRONTEND_STATUS_DISABLED) != 0) {
			admin_forget_the_queues();
			nvme_frontend_acknowledge(ssd_frontend, NVME_FRONTEND_STATUS_DISABLED);
		}
		/*
		 * There is nothing to start up, so the firmware is ready at
		 * once. If the host has changed its mind again by now, the
		 * frontend does not hear this, and says so in its own time.
		 */
		if ((happened & NVME_FRONTEND_STATUS_ENABLED) != 0) {
			nvme_frontend_acknowledge(ssd_frontend, NVME_FRONTEND_STATUS_ENABLED);
			nvme_frontend_say_ready(ssd_frontend);
		}
		if ((happened & NVME_FRONTEND_STATUS_COMMAND_WAITING) != 0) {
			deal_with_the_command();
		}
		/*
		 * The power is about to go: the table goes to the NAND, where
		 * the next start finds it, and then the host is told the
		 * shutdown is complete. If the NAND would not take it, the
		 * host is not told, and gives up waiting in its own time; and
		 * the firmware stops, as it does with no NAND, since the
		 * shutdown it has not acknowledged would wake it again at once,
		 * for ever.
		 */
		if ((happened & NVME_FRONTEND_STATUS_SHUTDOWN) != 0) {
			if (ftl_save() != 0) {
				printk("The table would not go to the NAND, so the drive "
				       "will not find what was written to it. The SSD's "
				       "firmware stops.\n");
				return 0;
			}
			nvme_frontend_acknowledge(ssd_frontend, NVME_FRONTEND_STATUS_SHUTDOWN);
		}
	}

	return 0;
}
```

## src/admin.c
```c
/*
 * The admin commands: Identify, Set Features, and the two that create an
 * I/O queue.
 */

#include <stdbool.h>
#include <string.h>

#include <zephyr/sys/byteorder.h>
#include <zephyr/sys/util.h>

#include <socpuppet/drivers/dma_engine.h>
#include <socpuppet/drivers/nvme_frontend.h>

#include "data.h"
#include "ssd.h"

/* What Identify can be asked for. */
#define THE_NAMESPACE_ITSELF  0x00
#define THE_CONTROLLER        0x01
#define THE_ACTIVE_NAMESPACES 0x02

/* The one feature there is to set. */
#define NUMBER_OF_QUEUES 0x07

/*
 * The I/O queues the host has had created, by identifier. The frontend
 * keeps the queues themselves. This is the firmware's own record of which
 * exist, which it needs to tell the host what it may not have.
 */
#define MOST_QUEUE_PAIRS 64
static bool completion_queues[MOST_QUEUE_PAIRS + 1];
static bool submission_queues[MOST_QUEUE_PAIRS + 1];

void admin_forget_the_queues(void)
{
	memset(completion_queues, 0, sizeof(completion_queues));
	memset(submission_queues, 0, sizeof(submission_queues));
}

/* What the frontend has, and so what the host may ask for. */
static struct nvme_frontend_limits limits;

void admin_start(void)
{
	nvme_frontend_get_limits(ssd_frontend, &limits);
	limits.io_queue_pairs = MIN(limits.io_queue_pairs, MOST_QUEUE_PAIRS);
}

/* Sends the scratch page to where a command's data goes. */
static uint16_t send_the_scratch_page(const struct nvme_command *command)
{
	/* What is left of the page to send. */
	const uint8_t *from = ssd_scratch();
	struct data data;
	struct data_piece piece;
	uint16_t status;

	/*
	 * One page of data is in one piece, or two if it does not start at the
	 * start of a page of the host's memory. It never needs a list, which
	 * is as well: a list would be fetched into the scratch page.
	 */
	data_begin(&data, command, NVME_HOST_PAGE);
	while ((status = data_next(&data, &piece)) == NVME_SUCCESS && piece.length != 0) {
		if (dma_engine_copy_to_host(ssd_dma, piece.address, from, piece.length) != 0) {
			return NVME_DATA_TRANSFER_ERROR;
		}
		from += piece.length;
	}

	return status;
}

/*
 * Identify: the host asks what the controller is and what it holds, and
 * gets a 4 KiB page of description back.
 */
static uint16_t identify(const struct nvme_command *command)
{
	uint8_t *page = ssd_scratch();
	uint64_t blocks = io_drive_blocks();

	memset(page, 0, NVME_HOST_PAGE);
	switch (nvme_dword(command, 10) & 0xFF) {
	case THE_CONTROLLER:
		/* How many namespaces there are, at offset 516. */
		sys_put_le32(1, &page[516]);
		break;
	case THE_NAMESPACE_ITSELF:
		if (nvme_namespace(command) != NVME_THE_NAMESPACE) {
			return NVME_INVALID_NAMESPACE;
		}
		/*
		 * Its size and its capacity in blocks, and at offset 128 the
		 * first block format, whose third byte is the block size as a
		 * power of two: 2 to the 9th is 512.
		 */
		sys_put_le64(blocks, &page[0]);
		sys_put_le64(blocks, &page[8]);
		page[130] = 9;
		break;
	case THE_ACTIVE_NAMESPACES:
		sys_put_le32(NVME_THE_NAMESPACE, &page[0]);
		break;
	default:
		return NVME_INVALID_FIELD;
	}

	return send_the_scratch_page(command);
}

/*
 * Set Features: the host changes a setting. The one every driver changes
 * is how many I/O queues it would like.
 */
static struct nvme_outcome set_features(const struct nvme_command *command)
{
	/*
	 * The answer is how many I/O queues the drive has, whatever the host
	 * asked for, counted from zero: submission queues in the low half,
	 * completion queues in the high half.
	 */
	uint32_t from_zero = limits.io_queue_pairs - 1;

	if ((nvme_dword(command, 10) & 0xFF) != NUMBER_OF_QUEUES) {
		return (struct nvme_outcome){.status = NVME_INVALID_FIELD};
	}

	return (struct nvme_outcome){.status = NVME_SUCCESS, .result = from_zero << 16 | from_zero};
}

/*
 * Whether the host may have an I/O queue with this identifier. Queue 0 is
 * the admin queue, and there are only so many.
 */
static bool is_an_io_queue(uint32_t queue_id)
{
	return queue_id >= 1 && queue_id <= limits.io_queue_pairs;
}

/*
 * Create I/O Completion Queue, and Create I/O Submission Queue. The host
 * has set a ring aside in its memory and says where it is and how long.
 * Both are asked for the same way: the identifier in the low half of dword
 * 10, the size, counted from zero, in the high half, and where the queue
 * is in the first data pointer.
 *
 * The firmware decides whether the host may have the queue, and if so has
 * the frontend create it.
 */
static uint16_t create_queue(const struct nvme_command *command, uint32_t kind)
{
	bool *queues = kind == NVME_FRONTEND_QUEUE_CREATE_COMPLETION_QUEUE ? completion_queues
									   : submission_queues;
	struct nvme_frontend_queue queue = {
		.kind = kind,
		.id = nvme_dword(command, 10) & 0xFFFF,
		.base = nvme_data(command),
		.last_slot = nvme_dword(command, 10) >> 16,
		/*
		 * A completion queue's interrupt vector, or the completion
		 * queue of a submission queue: either way, the high half of
		 * dword 11.
		 */
		.link = nvme_dword(command, 11) >> 16,
	};

	if (!is_an_io_queue(queue.id) || queues[queue.id]) {
		return NVME_INVALID_QUEUE_IDENTIFIER;
	}
	/* A queue keeps one slot empty, so one of a single entry holds nothing. */
	if (queue.last_slot == 0) {
		return NVME_INVALID_QUEUE_SIZE;
	}
	if (kind == NVME_FRONTEND_QUEUE_CREATE_COMPLETION_QUEUE) {
		/* The vector has to be one the drive has. */
		if (queue.link >= limits.vectors) {
			return NVME_INVALID_INTERRUPT_VECTOR;
		}
	} else if (queue.link != 0 &&
		   (!is_an_io_queue(queue.link) || !completion_queues[queue.link])) {
		/*
		 * The completion queue has to be there first. The admin
		 * completion queue, number 0, always is.
		 */
		return NVME_COMPLETION_QUEUE_INVALID;
	}

	nvme_frontend_create_queue(ssd_frontend, &queue);
	queues[queue.id] = true;

	return NVME_SUCCESS;
}

struct nvme_outcome admin_command(const struct nvme_command *command)
{
	switch (nvme_opcode(command)) {
	case NVME_CREATE_IO_COMPLETION_QUEUE:
		return (struct nvme_outcome){
			.status =
				create_queue(command, NVME_FRONTEND_QUEUE_CREATE_COMPLETION_QUEUE)};
	case NVME_CREATE_IO_SUBMISSION_QUEUE:
		return (struct nvme_outcome){
			.status =
				create_queue(command, NVME_FRONTEND_QUEUE_CREATE_SUBMISSION_QUEUE)};
	case NVME_IDENTIFY:
		return (struct nvme_outcome){.status = identify(command)};
	case NVME_SET_FEATURES:
		return set_features(command);
	default:
		return (struct nvme_outcome){.status = NVME_INVALID_OPCODE};
	}
}
```

## src/buffer.c
```c
/* The SSD's buffer, and what is where in it. See ssd.h. */

#include <zephyr/devicetree.h>

#include "ssd.h"

/* From the board's devicetree. Zephyr does not manage this memory. */
#define BUFFER      DT_NODELABEL(ssd_buffer)
#define BUFFER_BASE ((uint8_t *)DT_REG_ADDR(BUFFER))
#define BUFFER_SIZE DT_REG_SIZE(BUFFER)

uint8_t *ssd_scratch(void)
{
	return BUFFER_BASE;
}

uint8_t *ssd_page_buffer(void)
{
	return BUFFER_BASE + NVME_HOST_PAGE;
}

void *ssd_buffer_after_a_page(uint32_t page_size, size_t *size)
{
	size_t used = NVME_HOST_PAGE + (size_t)page_size;

	*size = used < BUFFER_SIZE ? BUFFER_SIZE - used : 0;

	return BUFFER_BASE + used;
}
```

## src/data.c
```c
/* Where a command's data is in the host's memory. See data.h. */

#include "data.h"

#include <zephyr/sys/byteorder.h>
#include <zephyr/sys/util.h>

#include <socpuppet/drivers/dma_engine.h>

#include "ssd.h"

/* A pointer in a list is 64 bits. */
#define POINTER_SIZE 8

void data_begin(struct data *data, const struct nvme_command *command, uint32_t length)
{
	*data = (struct data){
		.first = nvme_data(command),
		.second = nvme_more_data(command),
		.left = length,
		.from = DATA_AT_THE_FIRST_POINTER,
	};
}

/*
 * Fetches as much of the list at `list` as its page of the host's memory
 * holds, into the scratch page.
 */
static uint16_t fetch_the_list(struct data *data, uint64_t list)
{
	uint32_t bytes = NVME_HOST_PAGE - (uint32_t)(list % NVME_HOST_PAGE);

	/* A list starts where a pointer can. */
	if (list % POINTER_SIZE != 0) {
		return NVME_PRP_OFFSET_INVALID;
	}
	if (dma_engine_copy_from_host(ssd_dma, list, ssd_scratch(), bytes) != 0) {
		return NVME_DATA_TRANSFER_ERROR;
	}
	data->pointers = bytes / POINTER_SIZE;
	data->next = 0;

	return NVME_SUCCESS;
}

static uint64_t pointer(uint32_t number)
{
	return sys_get_le64(ssd_scratch() + (POINTER_SIZE * number));
}

uint16_t data_next(struct data *data, struct data_piece *piece)
{
	uint16_t status;

	*piece = (struct data_piece){0};
	if (data->left == 0) {
		return NVME_SUCCESS;
	}

	switch (data->from) {
	case DATA_AT_THE_FIRST_POINTER:
		/* From wherever in its page the data starts, to the page's end. */
		piece->address = data->first;
		piece->length =
			MIN(data->left, NVME_HOST_PAGE - (uint32_t)(data->first % NVME_HOST_PAGE));
		data->from = DATA_AT_THE_SECOND_POINTER;
		break;
	case DATA_AT_THE_SECOND_POINTER:
		if (data->left <= NVME_HOST_PAGE) {
			piece->address = data->second;
			piece->length = data->left;
			break;
		}
		/* More than a page is left, so the second pointer is to a list. */
		status = fetch_the_list(data, data->second);
		if (status != NVME_SUCCESS) {
			return status;
		}
		data->from = DATA_IN_A_LIST;
		__fallthrough;
	case DATA_IN_A_LIST:
		/*
		 * The last pointer of a list that fills its page points on to
		 * more of the list, if more than one page of data is to come.
		 */
		if (data->next == data->pointers - 1 && data->left > NVME_HOST_PAGE) {
			status = fetch_the_list(data, pointer(data->next));
			if (status != NVME_SUCCESS) {
				return status;
			}
		}
		piece->address = pointer(data->next++);
		piece->length = MIN(data->left, NVME_HOST_PAGE);
		break;
	}
	data->left -= piece->length;

	return NVME_SUCCESS;
}
```

## src/data.h
```c
/*
 * Where a command's data is in the host's memory, and moving it.
 *
 * NVMe says where data is page by page (PRPs, physical region pages). The
 * first pointer is to the data itself, and may start anywhere in a page of
 * the host's memory. If what is left after that page fits in one more, the
 * second pointer is to it. Otherwise the second pointer is to a list of
 * pointers, a page each, and a list that fills its own page ends with a
 * pointer to more of the list.
 *
 * So the data is in pieces, each inside one page of the host's memory, and
 * the firmware has to follow the pointers to find them:
 *
 *	struct data data;
 *	struct data_piece piece;
 *
 *	data_begin(&data, command, length);
 *	while ((status = data_next(&data, &piece)) == NVME_SUCCESS &&
 *	       piece.length != 0) {
 *		... move piece.length bytes at piece.address ...
 *	}
 */

#ifndef FIRMWARE_SSD_DATA_H_
#define FIRMWARE_SSD_DATA_H_

#include <stdint.h>

#include "nvme.h"

/* One piece of a command's data: a run of bytes in the host's memory. */
struct data_piece {
	uint64_t address;
	uint32_t length;
};

/* How far the firmware has got through a command's data. */
struct data {
	/* The command's two pointers. */
	uint64_t first;
	uint64_t second;
	/* How many bytes are still to come. */
	uint32_t left;
	/* Which pointer the next piece comes from. */
	enum {
		DATA_AT_THE_FIRST_POINTER,
		DATA_AT_THE_SECOND_POINTER,
		DATA_IN_A_LIST,
	} from;
	/*
	 * The list being followed: how many pointers of it are in the scratch
	 * page, and which is next.
	 */
	uint32_t pointers;
	uint32_t next;
};

/* Starts at the beginning of the `length` bytes of a command's data. */
void data_begin(struct data *data, const struct nvme_command *command, uint32_t length);

/*
 * Finds the next piece. Returns NVME_SUCCESS with the piece, whose length
 * is 0 when there is no more. Or returns how the command has failed: the
 * host's list of pointers is not where a list can be, or could not be
 * fetched.
 *
 * A list is fetched into the scratch page, so the scratch page is not for
 * anything else until the data has been gone through.
 */
uint16_t data_next(struct data *data, struct data_piece *piece);

#endif /* FIRMWARE_SSD_DATA_H_ */
```

## src/ftl.c
```c
/* The flash translation layer. See ftl.h. */

#include "ftl.h"

#include <errno.h>
#include <stdbool.h>
#include <string.h>

#include <zephyr/drivers/flash.h>
#include <zephyr/sys/byteorder.h>
#include <zephyr/sys/printk.h>
#include <zephyr/sys/util.h>

#include <socpuppet/regs/ftl_header.h>

#include "ssd.h"

/*
 * How much of a flash Zephyr's flash API has offsets for. An offset is an
 * off_t, which is signed, and 32 bits on a 32-bit CPU: 2 GiB, then. See
 * docs/upstream.md in socpuppet.
 */
#define FLASH_API_REACH (1ULL << (8 * sizeof(off_t) - 1))
#define MiB             (1ULL << 20)

/* In the table, a page of the drive that is in no NAND page. */
#define NOWHERE    UINT32_MAX
/* How many bytes an entry of the table takes. */
#define ENTRY_SIZE sizeof(uint32_t)

static uint32_t page_size;
/* How many pages the drive has: the NAND less the reserve. */
static uint32_t pages;
/* How many of the NAND's pages, at its start, are the reserve. */
static uint32_t reserve;
/*
 * How many bytes the table takes: whole pages, as on the NAND, from the
 * reserve's second page. The first is the header.
 */
static size_t table_bytes;
/*
 * For each page of the drive, the NAND page that holds it. The table is
 * whole pages, as it is on the NAND: the entries past the drive's last
 * page are NOWHERE.
 */
static uint32_t *where;
/* The next NAND page nobody has. */
static uint32_t next_free_nand_page;

/*
 * How many of the NAND's blocks, at its start, are the FTL's reserve,
 * where it keeps its table: the fewest whole blocks that hold a header
 * page and an entry for each of the NAND's pages. socpuppet.ftl in
 * socpuppet works it out the same way, and docs/models/ssd-firmware.md
 * says why.
 */
static uint32_t reserved_blocks(uint32_t nand_blocks, uint32_t pages_per_block,
				uint32_t nand_page_size)
{
	uint64_t needed = nand_page_size + (uint64_t)ENTRY_SIZE * pages_per_block * nand_blocks;
	uint64_t block_size = (uint64_t)pages_per_block * nand_page_size;

	return (uint32_t)((needed + block_size - 1) / block_size);
}

uint32_t ftl_pages(void)
{
	return pages;
}

uint32_t ftl_page_size(void)
{
	return page_size;
}

/*
 * Whether every page the table gives out is one the NAND has given: the
 * pages given out so far are the reserve's end up to the next free one,
 * which is at most the NAND's end. socpuppet.ftl's saved_table judges the
 * same way.
 */
static bool can_be_this_drives(void)
{
	if (next_free_nand_page < reserve || next_free_nand_page > reserve + pages) {
		return false;
	}
	for (uint32_t page = 0; page < pages; ++page) {
		if (where[page] != NOWHERE &&
		    (where[page] < reserve || where[page] >= next_free_nand_page)) {
			return false;
		}
	}

	return true;
}

/*
 * The table the reserve holds, if its header says it is this drive's and
 * the table can be; else an empty one, as on a NAND fresh from the
 * factory, whose erased header says nothing. If the NAND will not give up
 * the reserve, says so.
 */
static int load_the_table(void)
{
	uint8_t *header = ssd_page_buffer();
	int result = flash_read(ssd_nand, 0, header, page_size);
	bool this_drives = false;

	if (result == 0 && sys_get_le32(&header[FTL_HEADER_MAGIC]) == FTL_HEADER_MAGIC_NUMBER &&
	    sys_get_le32(&header[FTL_HEADER_VERSION]) == FTL_HEADER_VERSION_FIRST &&
	    sys_get_le32(&header[FTL_HEADER_PAGES]) == pages) {
		next_free_nand_page = sys_get_le32(&header[FTL_HEADER_NEXT_FREE]);
		result = flash_read(ssd_nand, page_size, where, table_bytes);
		this_drives = result == 0 && can_be_this_drives();
		if (result == 0 && !this_drives) {
			printk("The reserve's table cannot be this drive's, so the drive starts "
			       "empty.\n");
		}
	}
	if (result == 0 && !this_drives) {
		for (size_t entry = 0; entry < table_bytes / ENTRY_SIZE; ++entry) {
			where[entry] = NOWHERE;
		}
		next_free_nand_page = reserve;
	}
	if (result != 0) {
		printk("The NAND would not give the FTL its reserve, where the table is kept "
		       "(%d).\n",
		       result);
	}

	return result;
}

int ftl_start(void)
{
	uint64_t bytes;
	size_t room;

	/*
	 * The NAND is written a page at a time and erased a block at a time,
	 * which Zephyr's flash API calls a page.
	 */
	struct flash_pages_info block;

	if (!device_is_ready(ssd_nand) || flash_get_size(ssd_nand, &bytes) != 0 ||
	    flash_get_page_info_by_offs(ssd_nand, 0, &block) != 0) {
		printk("The flash controller's driver did not start (it says why above), so there "
		       "is no NAND.\n");
		return -ENODEV;
	}
	/* Every page has to be somewhere flash_read() can be told to go. */
	if (bytes > FLASH_API_REACH) {
		printk("The NAND is %u MiB, and Zephyr's flash API reaches only the first %u MiB "
		       "of one on this CPU. Describe a smaller drive.\n",
		       (uint32_t)(bytes / MiB), (uint32_t)(FLASH_API_REACH / MiB));
		return -EFBIG;
	}
	page_size = flash_get_write_block_size(ssd_nand);
	uint32_t pages_per_block = block.size / page_size;
	uint32_t nand_blocks = bytes / block.size;
	/* The drive is the NAND's pages after the reserve. */
	reserve = reserved_blocks(nand_blocks, pages_per_block, page_size) * pages_per_block;
	pages = (nand_blocks * pages_per_block) - reserve;
	table_bytes = ROUND_UP((size_t)pages * ENTRY_SIZE, page_size);

	/*
	 * The table has what is left of the buffer, and has to fit. On this
	 * board it always does: a NAND the flash API can reach needs half of
	 * what there is. A board with a smaller buffer is what this is for.
	 */
	where = ssd_buffer_after_a_page(page_size, &room);
	if (room < table_bytes) {
		printk("A table for %u pages does not fit in what is left of the buffer, %u "
		       "bytes. Describe a smaller drive, or a bigger buffer.\n",
		       pages, (uint32_t)room);
		return -ENOMEM;
	}

	return load_the_table();
}

int ftl_save(void)
{
	/*
	 * The reserve is erased whole, the table programmed, and the header
	 * last: until the header is there, the reserve holds no table at all.
	 */
	int result = flash_erase(ssd_nand, 0, (size_t)reserve * page_size);

	if (result == 0) {
		result = flash_write(ssd_nand, page_size, where, table_bytes);
	}
	if (result == 0) {
		uint8_t *header = ssd_page_buffer();

		memset(header, 0xFF, page_size);
		sys_put_le32(FTL_HEADER_MAGIC_NUMBER, &header[FTL_HEADER_MAGIC]);
		sys_put_le32(FTL_HEADER_VERSION_FIRST, &header[FTL_HEADER_VERSION]);
		sys_put_le32(pages, &header[FTL_HEADER_PAGES]);
		sys_put_le32(next_free_nand_page, &header[FTL_HEADER_NEXT_FREE]);
		result = flash_write(ssd_nand, 0, header, page_size);
	}

	return result;
}

int ftl_load(uint32_t page)
{
	if (where[page] == NOWHERE) {
		memset(ssd_page_buffer(), 0, page_size);
		return 0;
	}

	return flash_read(ssd_nand, (off_t)where[page] * page_size, ssd_page_buffer(), page_size);
}

int ftl_store(uint32_t page)
{
	uint32_t nand_page = where[page] == NOWHERE ? next_free_nand_page : where[page];
	int result =
		flash_write(ssd_nand, (off_t)nand_page * page_size, ssd_page_buffer(), page_size);

	/* The table says so only once it is true. */
	if (result == 0 && where[page] == NOWHERE) {
		where[page] = nand_page;
		++next_free_nand_page;
	}

	return result;
}
```

## src/ftl.h
```c
/*
 * The flash translation layer (FTL): what turns the drive's pages into
 * pages of NAND.
 *
 * The host sees a drive of numbered blocks. A NAND chip has pages, of
 * several blocks each, and no page of it is any block's home: the firmware
 * decides where each page of the drive is kept, and keeps a table of it. An
 * FTL calls that its logical-to-physical table, L2P for short.
 *
 * This one is as small as an FTL can be:
 *
 *   - A page of the drive that was never written is nowhere, and reads as
 *     zeros. (An erased NAND page reads as all ones. The zeros a host
 *     expects of a new drive are the firmware's.)
 *   - A page written for the first time takes the next NAND page nobody
 *     has.
 *   - A page written again is programmed where it is. Only an ideal NAND
 *     allows that: a real one has to be given a fresh page, and the old one
 *     left as rubbish until its block is erased. That is where garbage
 *     collection begins, and where this FTL stops.
 *
 * The NAND's first blocks are a reserve, which no page of the drive goes
 * in: the drive is the NAND less the reserve, and its pages start after
 * it. It is where the table is to be kept (docs/models/ssd-firmware.md in
 * socpuppet). 🚧 For now the table is in the SSD's buffer and nowhere
 * else, so it does not outlive the firmware. A real FTL keeps it on the
 * NAND as well.
 */

#ifndef FIRMWARE_SSD_FTL_H_
#define FIRMWARE_SSD_FTL_H_

#include <stdint.h>

/*
 * Asks the NAND what it is and makes an empty table. Returns 0. If the
 * NAND cannot be used it says why on the console, with what to do about
 * it, and returns a negative errno. If it is the flash controller's driver
 * that did not start, the driver has said why, in the log.
 */
int ftl_start(void);

/* How many pages the drive has, and how many bytes one is. */
uint32_t ftl_pages(void);
uint32_t ftl_page_size(void);

/*
 * Puts a page of the drive in the page buffer: from the NAND, or as zeros
 * if it was never written. Returns 0, or a negative errno.
 */
int ftl_load(uint32_t page);

/*
 * Programs the page buffer into the NAND, as a page of the drive. Returns
 * 0, or a negative errno.
 *
 * A write of part of a page is why the page is loaded first: what is not
 * being written has to survive.
 */
int ftl_store(uint32_t page);

#endif /* FIRMWARE_SSD_FTL_H_ */
```

## src/io.c
```c
/* The I/O commands: Read, Write and Flush, on the one namespace. */

#include <stdbool.h>

#include <zephyr/sys/util.h>

#include <socpuppet/drivers/dma_engine.h>

#include "data.h"
#include "ftl.h"
#include "ssd.h"

uint64_t io_drive_blocks(void)
{
	return (uint64_t)ftl_pages() * (ftl_page_size() / NVME_BLOCK_SIZE);
}

/*
 * Read: the host asks for blocks, and they are copied into its memory.
 * Write: the other way.
 *
 * The command's data is in pieces, one for each page of the host's memory,
 * and the drive is in pages too, which do not line up with the host's. So
 * the firmware works through the drive a page at a time: it puts the page
 * in the buffer once, moves every piece of the data that is in that page,
 * and for a write programs the page once.
 */
static uint16_t read_or_write(const struct nvme_command *command)
{
	bool writing = nvme_opcode(command) == NVME_WRITE;
	/*
	 * NVMe calls a block's number its LBA, logical block address. The
	 * first is in dwords 10 and 11, and how many blocks, counted from
	 * zero, in the low half of dword 12.
	 */
	uint64_t first = (uint64_t)nvme_dword(command, 11) << 32 | nvme_dword(command, 10);
	uint32_t count = (nvme_dword(command, 12) & 0xFFFF) + 1;
	uint64_t at = first * NVME_BLOCK_SIZE;
	/* Which page of the drive is in the buffer, if one is. */
	bool have_a_page = false;
	uint32_t in_the_buffer = 0;
	struct data data;
	struct data_piece piece;
	uint16_t status;

	if (nvme_namespace(command) != NVME_THE_NAMESPACE) {
		return NVME_INVALID_NAMESPACE;
	}
	if (first > io_drive_blocks() || count > io_drive_blocks() - first) {
		return NVME_LBA_OUT_OF_RANGE;
	}

	data_begin(&data, command, count * NVME_BLOCK_SIZE);
	for (;;) {
		status = data_next(&data, &piece);
		if (status != NVME_SUCCESS) {
			return status;
		}
		if (piece.length == 0) {
			break;
		}
		/* A piece ends where the drive's page does, if that is sooner. */
		while (piece.length != 0) {
			uint32_t page = at / ftl_page_size();
			uint32_t offset = at % ftl_page_size();
			uint32_t length = MIN(piece.length, ftl_page_size() - offset);
			uint8_t *in_the_page = ssd_page_buffer() + offset;
			int result;

			if (!have_a_page || page != in_the_buffer) {
				if (writing && have_a_page && ftl_store(in_the_buffer) != 0) {
					return NVME_INTERNAL_ERROR;
				}
				if (ftl_load(page) != 0) {
					return NVME_INTERNAL_ERROR;
				}
				in_the_buffer = page;
				have_a_page = true;
			}
			result = writing ? dma_engine_copy_from_host(ssd_dma, piece.address,
								     in_the_page, length)
					 : dma_engine_copy_to_host(ssd_dma, piece.address,
								   in_the_page, length);
			if (result != 0) {
				return NVME_DATA_TRANSFER_ERROR;
			}
			at += length;
			piece.address += length;
			piece.length -= length;
		}
	}
	if (writing && have_a_page && ftl_store(in_the_buffer) != 0) {
		return NVME_INTERNAL_ERROR;
	}

	return NVME_SUCCESS;
}

struct nvme_outcome io_command(const struct nvme_command *command)
{
	switch (nvme_opcode(command)) {
	case NVME_FLUSH:
		/* Everything written is already in the NAND. */
		return (struct nvme_outcome){.status = NVME_SUCCESS};
	case NVME_READ:
	case NVME_WRITE:
		return (struct nvme_outcome){.status = read_or_write(command)};
	default:
		return (struct nvme_outcome){.status = NVME_INVALID_OPCODE};
	}
}
```

## src/nvme.h
```c
/*
 * NVMe, as much of it as this firmware speaks, from the NVMe base
 * specification, which is public.
 */

#ifndef FIRMWARE_SSD_NVME_H_
#define FIRMWARE_SSD_NVME_H_

#include <stdint.h>

#include <zephyr/sys/byteorder.h>

/* A drive's block is 512 bytes. */
#define NVME_BLOCK_SIZE    512
/*
 * The host says where a command's data is in pages of its memory, of 4 KiB
 * each.
 */
#define NVME_HOST_PAGE     4096
/* There is one namespace, and namespaces are numbered from 1. */
#define NVME_THE_NAMESPACE 1

/*
 * A command: 64 bytes, as the host wrote them into a submission queue.
 * Numbers in it are little-endian, wherever the firmware runs.
 */
struct nvme_command {
	uint8_t bytes[64];
};

static inline uint8_t nvme_opcode(const struct nvme_command *command)
{
	return command->bytes[0];
}

/* One of the command's sixteen 32-bit words, counted from 0. */
static inline uint32_t nvme_dword(const struct nvme_command *command, unsigned int number)
{
	return sys_get_le32(&command->bytes[4 * number]);
}

static inline uint32_t nvme_namespace(const struct nvme_command *command)
{
	return nvme_dword(command, 1);
}

/*
 * Where the command's data is in the host's memory: its first page, and
 * either its second page or a list of the rest (see data.h).
 */
static inline uint64_t nvme_data(const struct nvme_command *command)
{
	return sys_get_le64(&command->bytes[24]);
}

static inline uint64_t nvme_more_data(const struct nvme_command *command)
{
	return sys_get_le64(&command->bytes[32]);
}

/* Admin commands. */
#define NVME_CREATE_IO_SUBMISSION_QUEUE 0x01
#define NVME_CREATE_IO_COMPLETION_QUEUE 0x05
#define NVME_IDENTIFY                   0x06
#define NVME_SET_FEATURES               0x09

/* I/O commands. */
#define NVME_FLUSH 0x00
#define NVME_WRITE 0x01
#define NVME_READ  0x02

/*
 * How a command went. A status is a code and which list the code is from:
 * the one every command shares (type 0), or the command's own (type 1).
 * Here the code is the low byte and the type is above it, which is how the
 * NVMe frontend takes it.
 */
#define NVME_OF_THE_COMMAND(code) (0x100 | (code))

#define NVME_SUCCESS             0x00
#define NVME_INVALID_OPCODE      0x01
#define NVME_INVALID_FIELD       0x02
#define NVME_DATA_TRANSFER_ERROR 0x04
#define NVME_INTERNAL_ERROR      0x06
#define NVME_INVALID_NAMESPACE   0x0B
#define NVME_PRP_OFFSET_INVALID  0x13
#define NVME_LBA_OUT_OF_RANGE    0x80

/* Of the two commands that create a queue. */
#define NVME_COMPLETION_QUEUE_INVALID NVME_OF_THE_COMMAND(0x00)
#define NVME_INVALID_QUEUE_IDENTIFIER NVME_OF_THE_COMMAND(0x01)
#define NVME_INVALID_QUEUE_SIZE       NVME_OF_THE_COMMAND(0x02)
#define NVME_INVALID_INTERRUPT_VECTOR NVME_OF_THE_COMMAND(0x08)

/* What a command's completion will say: its status, and its answer. */
struct nvme_outcome {
	uint16_t status;
	/* For the few commands that have an answer of 32 bits. */
	uint32_t result;
};

#endif /* FIRMWARE_SSD_NVME_H_ */
```

## src/ssd.h
```c
/*
 * The SSD's hardware, as its firmware reaches it, and the parts of the
 * firmware as they call each other.
 */

#ifndef FIRMWARE_SSD_SSD_H_
#define FIRMWARE_SSD_SSD_H_

#include <stdbool.h>
#include <stddef.h>
#include <stdint.h>

#include <socpuppet/drivers/nvme_frontend.h>
#include <zephyr/device.h>

#include "nvme.h"

/*
 * The three devices: the NVMe frontend, which keeps the host's queues, the
 * DMA engine, which copies to and from the host's memory, and the NAND,
 * through its flash controller.
 */
extern const struct device *const ssd_frontend;
extern const struct device *const ssd_dma;
extern const struct device *const ssd_nand;

/*
 * The buffer: the SSD's own memory that data passes through on its way
 * between the host and the NAND. The firmware keeps three things in it,
 * in this order (buffer.c).
 */
/*
 * A page of scratch, for what the firmware makes up to send to the host,
 * and for what it fetches from the host to read. It is one page of the
 * host's memory long.
 */
uint8_t *ssd_scratch(void);
/*
 * One page of the drive, as it is being read or written. How long it is
 * depends on the NAND.
 */
uint8_t *ssd_page_buffer(void);
/*
 * What is left after a page of the drive of `page_size` bytes: where it
 * starts, and in `size` how many bytes there are, which is none if the
 * page did not fit. The flash translation layer keeps its table here.
 */
void *ssd_buffer_after_a_page(uint32_t page_size, size_t *size);

/* admin.c: the commands that manage the controller. */
/* Asks the frontend what it has, once, before the first command. */
void admin_start(void);
struct nvme_outcome admin_command(const struct nvme_command *command);
/* The host has reset the controller: the I/O queues are gone. */
void admin_forget_the_queues(void);

/* io.c: the commands that read and write the drive. */
struct nvme_outcome io_command(const struct nvme_command *command);
/* How many blocks the drive has, as the host counts them. */
uint64_t io_drive_blocks(void);

#endif /* FIRMWARE_SSD_SSD_H_ */
```
